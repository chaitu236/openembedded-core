## meta/conf/distro/include/default-versions.inc
```bitbake
#
# Default preferred versions
#

PREFERRED_VERSION_openssl = "3.5.%"
PREFERRED_VERSION_openssl-native = "3.5.%"
PREFERRED_VERSION_nativesdk-openssl = "3.5.%"
```
